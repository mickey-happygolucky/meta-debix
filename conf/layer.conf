## conf/layer.conf
```bitbake
# We have a conf and classes directory, add to BBPATH
BBPATH .= ":${LAYERDIR}"

# We have recipes-* directories, add to BBFILES
BBFILES += "${LAYERDIR}/recipes-*/*/*.bb \
            ${LAYERDIR}/recipes-*/*/*.bbappend"

BBFILE_COLLECTIONS += "meta-debix"
BBFILE_PATTERN_meta-debix = "^${LAYERDIR}/"
BBFILE_PRIORITY_meta-debix = "10"

LAYERDEPENDS_meta-debix = "core"
LAYERSERIES_COMPAT_meta-debix = "scarthgap"
```

## conf/machine/debix-a.conf
```bitbake
MACHINEOVERRIDES =. "imx8mp-lpddr4-evk:"
require conf/machine/imx8mp-lpddr4-evk.conf

IMX_DEFAULT_BOOTLOADER:debix-a = "u-boot-debix"
PREFERRED_PROVIDER_virtual/bootloader:debix-a = "u-boot-debix"

KERNEL_DEVICETREE:remove:debix-a = " \
	freescale/imx8mp-evk-dsp.dtb \
	freescale/imx8mp-evk-ecspi-slave.dtb \
	freescale/imx8mp-evk-ndm.dtb \
	freescale/imx8mp-evk-usdhc1-m2.dtb \
	freescale/imx8mp-evk-rm67199.dtb \
	freescale/imx8mp-ab2.dtb \
	freescale/imx8mp-evk-basler.dtb \
	freescale/imx8mp-evk-basler-ov2775.dtb \
	freescale/imx8mp-evk-basler-ov5640.dtb \
	freescale/imx8mp-evk-dual-basler.dtb \
	freescale/imx8mp-evk-dual-ov2775.dtb \
	freescale/imx8mp-evk-ecspi-slave.dtb \
	freescale/imx8mp-evk-flexcan2.dtb \
	freescale/imx8mp-evk-hifiberry-dacplus.dtb \
	freescale/imx8mp-evk-inmate.dtb \
	freescale/imx8mp-evk-iqaudio-dacplus.dtb \
	freescale/imx8mp-evk-iqaudio-dacpro.dtb \
	freescale/imx8mp-evk-it6263-lvds-dual-channel.dtb \
	freescale/imx8mp-evk-jdi-wuxga-lvds-panel.dtb \
	freescale/imx8mp-evk-ndm.dtb \
	freescale/imx8mp-evk-ov2775.dtb \
	freescale/imx8mp-evk-ov2775-ov5640.dtb \
	freescale/imx8mp-evk-pcie-ep.dtb \
	freescale/imx8mp-evk-rm67191.dtb \
	freescale/imx8mp-evk-rm67199.dtb \
	freescale/imx8mp-evk-root.dtb \
	freescale/imx8mp-evk-rpmsg.dtb \
	freescale/imx8mp-evk-sof-wm8960.dtb \
	freescale/imx8mp-evk-spdif-lb.dtb \
	freescale/imx8mp-evk-usdhc1-m2.dtb \
"
```

## conf/machine/imx8mp-debix-a.conf
```bitbake
MACHINEOVERRIDES =. "imx8mp-lpddr4-evk:"
require conf/machine/imx8mp-lpddr4-evk.conf
```

## conf/machine/imx8mp-debix-model-a.conf
```bitbake
require conf/machine/imx8mp-lpddr4-evk.conf
MACHINEOVERRIDES =. "imx8mp-lpddr4-evk:"

UBOOT_CONFIG_BASENAME = "imx8mp_debix_model_a"
UBOOT_DTB_NAME = "imx8mp-debix-model-a.dtb"

KERNEL_DEVICETREE:append:imx8mp-debix-model-a = " \
	freescale/imx8mp-debix-model-a.dtb \
"

IMAGE_BOOT_FILES += "boot.scr"
```
